## sdkconfig.defaults
```kconfig
# Enable Bluetooth Controller & Host
CONFIG_BT_ENABLED=y
CONFIG_BT_CONTROLLER_ONLY=n
CONFIG_BT_BLE_ENABLED=y

# Select Apache NimBLE as Host Stack
CONFIG_BT_NIMBLE_ENABLED=y
CONFIG_BT_BLUEDROID_ENABLED=n

# NimBLE Configuration
CONFIG_BT_NIMBLE_MAX_CONNECTIONS=1
CONFIG_BT_NIMBLE_ROLE_PERIPHERAL=y
CONFIG_BT_NIMBLE_ROLE_CENTRAL=n
CONFIG_BT_NIMBLE_ROLE_OBSERVER=n
CONFIG_BT_NIMBLE_ROLE_BROADCASTER=y
```
